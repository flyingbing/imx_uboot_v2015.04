## board/freescale/mx6qreadygo/Kconfig
```kconfig
if TARGET_MX6QREADYGO

config SYS_BOARD
	default "mx6qreadygo"

config SYS_VENDOR
	default "freescale"

config SYS_SOC
	default "mx6"

config SYS_CONFIG_NAME
	default "mx6qreadygo"

endif
```

## configs/mx6qreadygo_defconfig
```kconfig
CONFIG_SYS_EXTRA_OPTIONS="IMX_CONFIG=board/freescale/mx6qreadygo/mx6q_readygo_ddr.cfg,MX6Q,SYS_USE_SPINOR"
CONFIG_ARM=y
CONFIG_TARGET_MX6QREADYGO=y

CONFIG_DM=y
CONFIG_DM_THERMAL=y
```
